## Kconfig
```kconfig
config CIFS_SERVER
	tristate "CIFS server support"
	depends on INET
	select NLS
	select NLS_UTF8
	select CRYPTO
	select CRYPTO_MD4
	select CRYPTO_MD5
	select CRYPTO_HMAC
	select CRYPTO_ARC4
	select CRYPTO_ECB
	select CRYPTO_DES
	select CRYPTO_SHA256
	select CRYPTO_CMAC
	select CRYPTO_SHA512
	select CRYPTO_AEAD2
	select CRYPTO_CCM
	select CRYPTO_GCM
	help
	  This config provides support for in-kernel CIFS/SMB3 server.

config CIFS_INSECURE_SERVER
        bool "Support for insecure SMB1/CIFS and SMB2.0 protocols"
        depends on CIFS_SERVER && INET
        select NLS
	default n

        help
	  This enables deprecated insecure protocols dialects: SMB1/CIFS
	  and SMB2.0

config CIFS_SERVER_SMBDIRECT
	bool "Support for SMB Direct protocol"
	depends on CIFS_SERVER && INFINIBAND && INFINIBAND_ADDR_TRANS
	default n
	help
	  This enables SMB direct protocol for SMB 3.x
```
